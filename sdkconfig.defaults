## sdkconfig.defaults
```kconfig
CONFIG_BOOTLOADER_COMPILER_OPTIMIZATION_PERF=y
CONFIG_BOOTLOADER_LOG_LEVEL_NONE=y
CONFIG_BOOT_ROM_LOG_ALWAYS_OFF=y
CONFIG_ESPTOOLPY_FLASHMODE_QIO=y
CONFIG_ESPTOOLPY_FLASHSIZE_4MB=y
CONFIG_PARTITION_TABLE_CUSTOM=y
CONFIG_AUDIO_BOARD_CUSTOM=y
CONFIG_COMPILER_OPTIMIZATION_PERF=y
CONFIG_GPTIMER_SUPPRESS_DEPRECATE_WARN=y
CONFIG_DAC_CTRL_FUNC_IN_IRAM=y
CONFIG_DAC_ISR_IRAM_SAFE=y
CONFIG_GPIO_CTRL_FUNC_IN_IRAM=y
CONFIG_GPTIMER_CTRL_FUNC_IN_IRAM=y
CONFIG_GPTIMER_ISR_IRAM_SAFE=y
CONFIG_I2S_ISR_IRAM_SAFE=y
CONFIG_LEDC_CTRL_FUNC_IN_IRAM=y
CONFIG_PCNT_CTRL_FUNC_IN_IRAM=y
CONFIG_PCNT_ISR_IRAM_SAFE=y
CONFIG_RMT_ISR_IRAM_SAFE=y
CONFIG_RMT_RECV_FUNC_IN_IRAM=y
CONFIG_SDM_CTRL_FUNC_IN_IRAM=y
CONFIG_TOUCH_CTRL_FUNC_IN_IRAM=y
CONFIG_TOUCH_ISR_IRAM_SAFE=y
CONFIG_UART_ISR_IN_IRAM=y
CONFIG_ESP_DEFAULT_CPU_FREQ_MHZ_240=y
CONFIG_ESP32S2_INSTRUCTION_CACHE_16KB=y
CONFIG_ESP32S2_DATA_CACHE_16KB=y
CONFIG_ESP_SYSTEM_PANIC_REBOOT_DELAY_SECONDS=1
CONFIG_ESP_MAIN_TASK_STACK_SIZE=64000
CONFIG_ESP_CONSOLE_UART_CUSTOM=y
CONFIG_ESP_CONSOLE_UART_TX_GPIO=21
CONFIG_ESP_CONSOLE_UART_RX_GPIO=-1
CONFIG_ESP_CONSOLE_UART_BAUDRATE=230400
CONFIG_ESP_INT_WDT_TIMEOUT_MS=1000
CONFIG_ESP_PANIC_HANDLER_IRAM=y
CONFIG_FATFS_LFN_STACK=y
CONFIG_FATFS_SECTOR_512=y
CONFIG_FATFS_CODEPAGE_DYNAMIC=y
CONFIG_FATFS_API_ENCODING_UTF_8=y
CONFIG_FATFS_VFS_FSTAT_BLKSIZE=128
CONFIG_FATFS_USE_LABEL=y
CONFIG_FREERTOS_HZ=1000
CONFIG_FREERTOS_ENABLE_BACKWARD_COMPATIBILITY=y
CONFIG_FREERTOS_WATCHPOINT_END_OF_STACK=y
CONFIG_LOG_DEFAULT_LEVEL_WARN=y
CONFIG_LOG_COLORS=y
CONFIG_LOG_TIMESTAMP_SOURCE_SYSTEM=y
CONFIG_LWIP_LOCAL_HOSTNAME="polo_trainer"
# CONFIG_SPIFFS_CACHE is not set
# CONFIG_SPIFFS_PAGE_CHECK is not set
CONFIG_SPIFFS_PAGE_SIZE=1024
# CONFIG_CODEC_ES8311_SUPPORT is not set
# CONFIG_CODEC_ES7210_SUPPORT is not set
# CONFIG_CODEC_ES7243_SUPPORT is not set
# CONFIG_CODEC_ES7243E_SUPPORT is not set
# CONFIG_CODEC_ES8156_SUPPORT is not set
# CONFIG_CODEC_AW88298_SUPPORT is not set
# CONFIG_CODEC_ES8374_SUPPORT is not set
# CONFIG_CODEC_ES8388_SUPPORT is not set
# CONFIG_CODEC_TAS5805M_SUPPORT is not set
CONFIG_TINYUSB_MSC_ENABLED=y
CONFIG_TINYUSB_MSC_BUFSIZE=8192
```
